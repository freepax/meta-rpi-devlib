## conf/layer.conf
```bitbake
# Dummy file to allow for meta-yocto -> meta-poky transition
#BBPATH =. "${LAYERDIR}/../meta-poky:"
#BBPATH =. "${LAYERDIR}:"

BBFILES += "${LAYERDIR}/*/*.bb"

# We have a conf and classes directory, add to BBPATH
BBPATH .= ":${LAYERDIR}"

# We have recipes-* directories, add to BBFILES
BBFILES += "${LAYERDIR}/recipes-*/*/*.bb"
#        ${LAYERDIR}/recipes-*/*/*.bbappend"

BBFILE_COLLECTIONS += "rpi-device-layer"
BBFILE_PATTERN_rpi-device-layer := "^${LAYERDIR}/"
BBFILE_PRIORITY_rpi-device-layer = "6"

# This should only be incremented on significant changes that will
# cause compatibility issues with other layers
LAYERVERSION_rpi-device-layer = "1"

LAYERDEPENDS_rpi-device-layer = "core"
```
